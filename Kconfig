## Kconfig
```kconfig
mainmenu "HIT-CGRA-Mapper Configuration Menu"

menu "Build Options"
choice
  prompt "Compiler"
  default CC_GPP
config CC_GPP
  bool "g++"
config CC_CLANG
  bool "clang++-12"
endchoice

config CC
  string
  default "g++" if CC_GPP
  default "clang" if CC_CLANG
  default "none"

choice
  prompt "Optimization Level"
  default CC_O2
config CC_O0
  bool "O0"
config CC_O1
  bool "O1"
config CC_O2
  bool "O2"
config CC_O3
  bool "O3"
endchoice

config CC_OPT
  string
  default "-O0" if CC_O0
  default "-O1" if CC_O1
  default "-O2" if CC_O2
  default "-O3" if CC_O3
  default "none"

config CC_DEBUG
  bool "Enable gdb information"
  default n
endmenu

menu "CGRA config"
config CGRA_INSTMEM_SIZE 
  int "Inst MEM size of each PE (uint:max number of Inst)"
  default 8
config CGRA_CONSTMEM_SIZE
	int "Const Mem size of each PE (uint:max number of const)"
	default 8
config CGRA_SHIFTCONSTMEM_SIZE
	int "Shift Const Mem size of each PE (uint:max number of shift const)"
	default 8
config CGRA_DATAMEM_SIZE
	int "Data Mem size of each PE (uint:max number of data)"
	default 128
endmenu

config CGRA_INFO
	bool "Print CGRA information"
	default y

config BITSTREAM_DUMP
	bool "Print the bitstrem input"
	default y
```
